/*
 * Dummy Keymap for UART-Controlled Shield
 * The actual logic is handled in the custom C module (uart_control.c)
 */

#include <dt-bindings/zmk/keys.h>
#include <dt-bindings/zmk/kscan_mock.h>

/ {
    keymap {
        compatible = "zmk,keymap";

        default_layer {
            bindings = <
                &none
            >;
        };
    };
};
